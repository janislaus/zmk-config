/*
 * Copyright (c) 2022 The ZMK Contributors
 *
 * SPDX-License-Identifier: MIT
 */

#include <dt-bindings/zmk/matrix_transform.h>

/ {
	chosen {
		zmk,kscan = &kscan0;
		zmk,matrix_transform = &default_transform;
	};
	kscan0: kscan {
		compatible = "zmk,kscan-gpio-matrix";
		label = "KSCAN";
		diode-direction = "col2row";
	};
};


